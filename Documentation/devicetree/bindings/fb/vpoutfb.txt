## Documentation/devicetree/bindings/fb/vpoutfb.txt
```
Elvees VPOUT framebuffer

Required properties:
- compatible: Should be "elvees,vpoutfb".
- reg: Address and length of the VPOUT control registers.
- interrupts: Should contain VPOUT interrupts.
- output: Phandle to HDMI display node or for the lcd-display node (see below for details).
  Lcd-display node must be described according to standard
  "Linux/Documentation/devicetree/bindings/video/display-timing.txt".
- format: Description of pixel format (see below for possible configurations)

Valid formats:
    r3g3b2 - 8-bit pixels
    x4r4g4b4 - 16-bit pixels
    x1r5g5b5 - 16-bit pixels
    r5g6b5 - 16-bit pixels
    r8g8b8 - 24-bit pixels
    x8r8g8b8 - 32-bit pixels

Optional properties:
 - clocks: Should contain phandles to all clocks needed for device operation.

* HDMI display node

Has to be an I2C client.

Required properties:
- compatible: Should be "ite,it66121".
- reg: Should be the device address on I2C bus.
- reset-gpios: GPIO for resetting the HDMI device.

Examples:

at070tn92: lcd-display {
	bits-per-pixel = <24>;
	bus-width = <24>;

	display-timings {
		800x480p60 {
			clock-frequency = <33300000>;
			hactive = <800>;
			vactive = <480>;
			hfront-porch = <85>;
			hback-porch = <85>;
			hsync-len = <86>;
			vback-porch = <15>;
			vfront-porch = <15>;
			vsync-len = <15>;
			hsync-active = <0>;
		};
	};
};

&i2c1 {
	it66121: it66121@4c {
		compatible = "ite,it66121";
		reg = <0x4c>;
		reset-gpios = <&gpioc 14 GPIO_ACTIVE_LOW>;
	};
};

framebuffer: framebuffer@38004000 {
	compatible = "elvees,vpoutfb";
	reg = <0x38004000 0x1000>;
	format = "x8r8g8b8";
	interrupts = <GIC_SPI 37 IRQ_TYPE_LEVEL_HIGH>;
	clocks = <&vpout_hclk>, <&vpout_aclk>;
	output = <&it66121>;
	# Or if connected to LCD display: output = <&at070tn92>;
};
```

## Documentation/devicetree/bindings/media/avico.txt
```
ELVEES Avico (a.k.a. VELcore-01)
--------------------------------

Avico is a VPU (Video Processing Unit) designed by RnD Center ELVEES.
It supports encoding and decoding several video streams simultaneously.

Required properties:

- compatible: Should be "elvees,avico".
- reg: Should contain two memory regions: register region and
  VRAM scratchpad memory region.
- interrupts: Should contain the VPU interrupt.
- clocks: Should contain the "pclk", "aclk", and "sclk" clocks, in the order
  determined by the clock-names property.
- clock-names: Should be "pclk", "aclk", and "sclk".

Example:

vpu: codec@37100000 {
	compatible = "elvees,avico";
	reg = <0x37100000 0x00010000>, <0x3b000000 0x01000000>;
	interrupts = <GIC_SPI 7 IRQ_TYPE_LEVEL_HIGH>;
	clocks = <&vpu_pclk>, <&vpu_aclk>, <&vpu_sclk>;
	clock-names = "pclk", "aclk", "sclk";
};
```

## Documentation/devicetree/bindings/mtd/arasan_nfc.txt
```
Arasan Nand Flash Controller with ONFI 2.2 support

Required properties:
- compatible: Should be "arasan,nfc-v2p99"
- reg: Memory map for module access
- interrupt-parent: Interrupt controller the interrupt is routed through
- interrupts: Should contain the interrupt for the device

Optional properties:
- arasan,has-mdma: Enables DMA support

for nand partition information please refer the below file
Documentation/devicetree/bindings/mtd/partition.txt

Example:
	nand0: nand@ff100000 {
		compatible = "arasan,nfc-v2p99"
		reg = <0xff100000 0x1000>;
		interrupt-parent = <&gic>;
		interrupts = <0 14 4>;
		arasan,has-mdma;
		partition@0 {
			label = "u-boot";
			reg = <0x0 0x0 0x1000000>;
		};
		(...)
	};
```

## arch/arm/plat-mcom/Kconfig
```kconfig
config PLAT_MCOM
	bool
	default n
	select ARCH_WANT_OPTIONAL_GPIOLIB
	select ARM_GIC
	select ARM_AMBA
	select CACHE_L2X0
	select HAVE_ARM_ARCH_TIMER
	select HAVE_ARM_SCU if SMP
	select HAVE_ARM_TWD if SMP
	select DW_APB_TIMER_OF
	select ARM_GLOBAL_TIMER
	select CLKSRC_ARM_GLOBAL_TIMER_SCHED_CLOCK
```
